## boards/shields/iskra/Kconfig
```kconfig
config ZMK_KEYBOARD_NAME
	default "Iskra"
    depends on ARDUINO_PRO_MICRO || BOARD_NICE_NANO_V2
```

## boards/shields/iskra/Kconfig.shield
```kconfig
config SHIELD_ISKRA
	def_bool $(shields_list_contains,iskra)
    depends on ARDUINO_PRO_MICRO
```
